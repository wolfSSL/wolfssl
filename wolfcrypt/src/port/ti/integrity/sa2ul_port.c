/* sa2ul_port.c
 *
 * Copyright (C) 2006-2026 wolfSSL Inc.
 *
 * This file is part of wolfSSL.
 *
 * wolfSSL is free software; you can redistribute it and/or modify
 * it under the terms of the GNU General Public License as published by
 * the Free Software Foundation; either version 3 of the License, or
 * (at your option) any later version.
 *
 * wolfSSL is distributed in the hope that it will be useful,
 * but WITHOUT ANY WARRANTY; without even the implied warranty of
 * MERCHANTABILITY or FITNESS FOR A PARTICULAR PURPOSE.  See the
 * GNU General Public License for more details.
 *
 * You should have received a copy of the GNU General Public License
 * along with this program; if not, write to the Free Software
 * Foundation, Inc., 51 Franklin Street, Fifth Floor, Boston, MA 02110-1335, USA
 */

/* WOLF_CRYPTO_CB device for the AM64x SA2UL: registers itself as a crypto
 * callback device and gets first refusal at AES-CBC/ECB/GCM and
 * SHA-224/256/384/512 operations before falling back to software.
 */

#include <wolfssl/wolfcrypt/libwolfssl_sources.h>

#if defined(WOLFSSL_TI_AM64X_A53_INTEGRITY)

#ifndef WOLF_CRYPTO_CB
    #error WOLFSSL_TI_AM64X_A53_INTEGRITY support requires WOLF_CRYPTO_CB to be defined
#endif

#include <wolfssl/wolfcrypt/aes.h>
#include <wolfssl/wolfcrypt/cryptocb.h>
#include <wolfssl/wolfcrypt/error-crypt.h>
#include <wolfssl/wolfcrypt/sha256.h>
#include <wolfssl/wolfcrypt/sha512.h>
#include <wolfssl/wolfcrypt/port/ti/integrity/sa2ul_port.h>

#ifdef NO_INLINE
    #include <wolfssl/wolfcrypt/misc.h>
#else
    #define WOLFSSL_MISC_INCLUDED
    #include <wolfcrypt/src/misc.c>
#endif

#ifdef WOLFSSL_SA2UL_DRIVER
#include <INTEGRITY.h>
#include <string.h>
#include <wolfssl/wolfcrypt/wc_encrypt.h> /* GCM_NONCE_MID_SZ */
#include <wolfssl/wolfcrypt/port/ti/integrity/sa2ul_iodevice.h>

/* Generated by intex from proj/myproject.int (sa2ul_ctrl_local,
 * sa2ul_data_local). Project-specific: any other INTEGRITY project using
 * this port must declare the same two shared MemoryRegions. */
#include "myproject_integrate.h"

#ifndef WOLFSSL_SA2UL_ECB_MIN_SZ
    #define WOLFSSL_SA2UL_ECB_MIN_SZ WC_AES_BLOCK_SIZE
#endif
/* Smallest complete message sent to SA2UL for SHA-224/256/384/512 (see
 * user_settings.h); shorter ones are finished in software. */
#ifndef WOLFSSL_SA2UL_HASH_MIN_SZ
    #define WOLFSSL_SA2UL_HASH_MIN_SZ 1
#endif

static IODevice gSa2ulDev = NULL;
static MemoryRegion gSa2ulCtrlMr = NULLMemoryRegion;
static MemoryRegion gSa2ulDataMr = NULLMemoryRegion;
static volatile struct Sa2ulCtrl *gSa2ulCtrl = NULL;
static volatile struct Sa2ulData *gSa2ulData = NULL;

/* Serializes the single shared ctrl/data page pair, the AES key cache and
 * the hash accumulator. Never held across a call back into wolfCrypt. */
static wolfSSL_Mutex gSa2ulMutex;
static int gSa2ulMutexInit = 0;

static int ti_sa2ul_lock(void)
{
    if (!gSa2ulMutexInit || wc_LockMutex(&gSa2ulMutex) != 0) {
        return -1;
    }
    return 0;
}

static void ti_sa2ul_unlock(void)
{
    (void)wc_UnLockMutex(&gSa2ulMutex);
}

/* caller holds gSa2ulMutex */
static int ti_sa2ul_iodevice_open(void)
{
    Address VirtFirst, VirtLast;

    if (gSa2ulDev != NULL) {
        return 0;
    }
    if (RequestResource((Object *)&gSa2ulDev, SA2UL_IODEVICE_NAME,
            "!systempassword") != Success) {
        gSa2ulDev = NULL;
        return -1;
    }

    gSa2ulCtrlMr = sa2ul_ctrl_local;
    if (GetMemoryRegionAddresses(gSa2ulCtrlMr, &VirtFirst, &VirtLast) != Success ||
            (VirtLast - VirtFirst + 1) < sizeof(struct Sa2ulCtrl)) {
        gSa2ulDev = NULL;
        return -1;
    }
    gSa2ulCtrl = (volatile struct Sa2ulCtrl *)VirtFirst;

    gSa2ulDataMr = sa2ul_data_local;
    if (GetMemoryRegionAddresses(gSa2ulDataMr, &VirtFirst, &VirtLast) != Success ||
            (VirtLast - VirtFirst + 1) < sizeof(struct Sa2ulData)) {
        gSa2ulDev = NULL;
        return -1;
    }
    gSa2ulData = (volatile struct Sa2ulData *)VirtFirst;

    return 0;
}

/* Caller holds gSa2ulMutex. Returns 0 if the request reached the driver;
 * the driver's own status is then in Ctrl->ret. Out is only written when
 * Ctrl->ret == SA2UL_DRIVER_OK. */
static int ti_sa2ul_IodeviceCall(struct Sa2ulCtrl *Ctrl, const byte *In,
        word32 InSz, byte *Out, word32 OutSz)
{
    byte dummy = 0;
    int ret = 0;

    if (ti_sa2ul_iodevice_open() != 0) {
        return CRYPTOCB_UNAVAILABLE;
    }
    if (InSz > SA2UL_MAX_BUF || OutSz > SA2UL_MAX_BUF) {
        return CRYPTOCB_UNAVAILABLE;
    }

    if (In != NULL && InSz != 0u) {
        if (CopyToMemoryRegionWithFlags(gSa2ulDataMr,
                (ExtendedAddress)(uintptr_t)gSa2ulData, (void *)In, InSz,
                ACCESS_DST_COHERENT) != Success) {
            ret = CRYPTOCB_UNAVAILABLE;
        }
    }

    if (ret == 0 && CopyToMemoryRegionWithFlags(gSa2ulCtrlMr,
            (ExtendedAddress)(uintptr_t)gSa2ulCtrl, Ctrl, sizeof(*Ctrl),
            ACCESS_DST_COHERENT) != Success) {
        ret = CRYPTOCB_UNAVAILABLE;
    }

    if (ret == 0 && ReadIODeviceStatus(gSa2ulDev, SA2UL_IODEVICE_STATUS_NUMBER,
            &dummy, 1) != Success) {
        ret = CRYPTOCB_UNAVAILABLE;
    }

    /* read back even on failure: the driver zeroes the key in the page */
    if (CopyFromMemoryRegionWithFlags(gSa2ulCtrlMr,
            (ExtendedAddress)(uintptr_t)gSa2ulCtrl, Ctrl, sizeof(*Ctrl),
            ACCESS_SRC_COHERENT) != Success) {
        ret = CRYPTOCB_UNAVAILABLE;
    }

    if (ret == 0 && Ctrl->ret == SA2UL_DRIVER_OK && Out != NULL && OutSz != 0u) {
        if (CopyFromMemoryRegionWithFlags(gSa2ulDataMr,
                (ExtendedAddress)(uintptr_t)gSa2ulData, Out, OutSz,
                ACCESS_SRC_COHERENT) != Success) {
            ret = CRYPTOCB_UNAVAILABLE;
        }
    }

    return ret;
}

#ifndef SA2UL_AES_KEY_CACHE_SIZE
#define SA2UL_AES_KEY_CACHE_SIZE 4
#endif

/* Raw AES keys by Aes object. SA2UL needs the raw key for every request,
 * and with WOLF_CRYPTO_CB_AES_SETKEY this is the only place it is seen.
 * Entries are wiped on wc_AesFree() (WOLF_CRYPTO_CB_FREE). */
struct Sa2ulAesKeyCacheEntry {
    const Aes *owner;
    byte key[SA2UL_MAX_KEY_BYTES];
    word32 keySz;
    /* GCM hash subkey H for this key, filled in by the driver on the first
     * GCM call (saves an ECB pass per call afterwards) */
    byte ghash[16];
    int ghashValid;
};

static struct Sa2ulAesKeyCacheEntry gSa2ulAesKeyCache[SA2UL_AES_KEY_CACHE_SIZE];
static unsigned int gSa2ulAesKeyCacheNext = 0;

/* caller holds gSa2ulMutex */
static void ti_sa2ul_AesCacheKey(const Aes *aes, const byte *key, word32 keySz)
{
    unsigned int i;

    if (keySz > SA2UL_MAX_KEY_BYTES) {
        return;
    }
    for (i = 0; i < SA2UL_AES_KEY_CACHE_SIZE; i++) {
        if (gSa2ulAesKeyCache[i].owner == aes) {
            break;
        }
    }
    if (i == SA2UL_AES_KEY_CACHE_SIZE) {
        i = gSa2ulAesKeyCacheNext;
        gSa2ulAesKeyCacheNext = (gSa2ulAesKeyCacheNext + 1u) % SA2UL_AES_KEY_CACHE_SIZE;
    }
    /* new key: drop the old key and its H */
    ForceZero(&gSa2ulAesKeyCache[i], sizeof(gSa2ulAesKeyCache[i]));
    gSa2ulAesKeyCache[i].owner = aes;
    XMEMCPY(gSa2ulAesKeyCache[i].key, key, keySz);
    gSa2ulAesKeyCache[i].keySz = keySz;
}

/* caller holds gSa2ulMutex. Returns aes's cache entry, or NULL. */
static struct Sa2ulAesKeyCacheEntry *ti_sa2ul_AesLookupKey(const Aes *aes)
{
    unsigned int i;

    for (i = 0; i < SA2UL_AES_KEY_CACHE_SIZE; i++) {
        if (gSa2ulAesKeyCache[i].owner == aes) {
            return &gSa2ulAesKeyCache[i];
        }
    }
    return NULL;
}

static int ti_sa2ul_AesSetKey(Aes *aes, const byte *key, word32 keySz)
{
    if (ti_sa2ul_lock() == 0) {
        ti_sa2ul_AesCacheKey(aes, key, keySz);
        ti_sa2ul_unlock();
    }
    /* software still expands the key, for fallback and for paths that
     * never reach the callback */
    return CRYPTOCB_UNAVAILABLE;
}

static void ti_sa2ul_AesForgetKey(const Aes *aes)
{
    unsigned int i;

    if (ti_sa2ul_lock() != 0) {
        return;
    }
    for (i = 0; i < SA2UL_AES_KEY_CACHE_SIZE; i++) {
        if (gSa2ulAesKeyCache[i].owner == aes) {
            ForceZero(&gSa2ulAesKeyCache[i], sizeof(gSa2ulAesKeyCache[i]));
        }
    }
    ti_sa2ul_unlock();
}

/* Look up the key, fill Ctrl, run it. Returns 0 if the driver ran (status
 * in Ctrl->ret), CRYPTOCB_UNAVAILABLE otherwise. Wipes key material. */
static int ti_sa2ul_AesRun(Aes *aes, struct Sa2ulCtrl *Ctrl, const byte *In,
        byte *Out, word32 Sz)
{
    int ret;
    struct Sa2ulAesKeyCacheEntry *entry;

    if (ti_sa2ul_lock() != 0) {
        return CRYPTOCB_UNAVAILABLE;
    }
    entry = ti_sa2ul_AesLookupKey(aes);
    if (entry == NULL) {
        ret = CRYPTOCB_UNAVAILABLE;
    }
    else {
        XMEMCPY(Ctrl->key, entry->key, entry->keySz);
        Ctrl->keyBytes = entry->keySz;
        if (entry->ghashValid) {
            XMEMCPY(Ctrl->ghash, entry->ghash, sizeof(entry->ghash));
            Ctrl->ghashValid = 1;
        }
        ret = ti_sa2ul_IodeviceCall(Ctrl, In, Sz, Out, Sz);
        /* the driver derived H this time: keep it for the next GCM call
         * (H depends only on the key, and is valid even when a decrypt's
         * tag check failed) */
        if (ret == 0 && !entry->ghashValid && Ctrl->ghashValid &&
                (Ctrl->ret == SA2UL_DRIVER_OK ||
                 Ctrl->ret == SA2UL_DRIVER_AUTH_FAILED)) {
            XMEMCPY(entry->ghash, Ctrl->ghash, sizeof(entry->ghash));
            entry->ghashValid = 1;
        }
    }
    ti_sa2ul_unlock();
    ForceZero(Ctrl->key, sizeof(Ctrl->key));
    ForceZero(Ctrl->ghash, sizeof(Ctrl->ghash));
    return ret;
}

static byte gSa2ulHashAccum[SA2UL_MAX_BUF];
static word32 gSa2ulHashAccumLen = 0;
static const void *gSa2ulHashOwner = NULL;

#endif /* WOLFSSL_SA2UL_DRIVER */

#if !defined(NO_AES) && !defined(WOLFSSL_TI_AM64X_A53_INTEGRITY_NO_AES)
static int check_aes_keylength(word32 keylen)
{
    if (keylen != AES_128_KEY_SIZE && keylen != AES_192_KEY_SIZE &&
            keylen != AES_256_KEY_SIZE)
        return BAD_FUNC_ARG;

#if !defined(WOLFSSL_AES_128)
    if (keylen == AES_128_KEY_SIZE)
        return BAD_FUNC_ARG;
#endif

#if !defined(WOLFSSL_AES_192)
    if (keylen == AES_192_KEY_SIZE)
        return BAD_FUNC_ARG;
#endif

#if !defined(WOLFSSL_AES_256)
    if (keylen == AES_256_KEY_SIZE)
        return BAD_FUNC_ARG;
#endif

    return 0;
}

#ifdef HAVE_AES_CBC
static int ti_sa2ul_AesCbcEncrypt(Aes* aes, byte* out, const byte* in,
        word32 sz)
{
#ifdef WOLFSSL_SA2UL_DRIVER
    struct Sa2ulCtrl ctrl;

    if (sz == 0u || (sz % WC_AES_BLOCK_SIZE) != 0u || sz > SA2UL_MAX_BUF) {
        return CRYPTOCB_UNAVAILABLE;
    }

    XMEMSET(&ctrl, 0, sizeof(ctrl));
    ctrl.op = SA2UL_OP_AES_CBC_ENCRYPT;
    ctrl.sz = sz;
    XMEMCPY(ctrl.iv, aes->reg, WC_AES_BLOCK_SIZE);

    if (ti_sa2ul_AesRun(aes, &ctrl, in, out, sz) != 0 ||
            ctrl.ret != SA2UL_DRIVER_OK) {
        return CRYPTOCB_UNAVAILABLE;
    }

    XMEMCPY(aes->reg, out + sz - WC_AES_BLOCK_SIZE, WC_AES_BLOCK_SIZE);
    return 0;
#else
    (void)aes; (void)out; (void)in; (void)sz;
    return CRYPTOCB_UNAVAILABLE;
#endif
}

#ifdef HAVE_AES_DECRYPT
static int ti_sa2ul_AesCbcDecrypt(Aes* aes, byte* out, const byte* in,
        word32 sz)
{
#ifdef WOLFSSL_SA2UL_DRIVER
    struct Sa2ulCtrl ctrl;
    byte nextIv[WC_AES_BLOCK_SIZE];

    if (sz == 0u || (sz % WC_AES_BLOCK_SIZE) != 0u || sz > SA2UL_MAX_BUF) {
        return CRYPTOCB_UNAVAILABLE;
    }

    /* in may alias out */
    XMEMCPY(nextIv, in + sz - WC_AES_BLOCK_SIZE, WC_AES_BLOCK_SIZE);

    XMEMSET(&ctrl, 0, sizeof(ctrl));
    ctrl.op = SA2UL_OP_AES_CBC_DECRYPT;
    ctrl.sz = sz;
    XMEMCPY(ctrl.iv, aes->reg, WC_AES_BLOCK_SIZE);

    if (ti_sa2ul_AesRun(aes, &ctrl, in, out, sz) != 0 ||
            ctrl.ret != SA2UL_DRIVER_OK) {
        return CRYPTOCB_UNAVAILABLE;
    }

    XMEMCPY(aes->reg, nextIv, WC_AES_BLOCK_SIZE);
    return 0;
#else
    (void)aes; (void)out; (void)in; (void)sz;
    return CRYPTOCB_UNAVAILABLE;
#endif
}
#endif /* HAVE_AES_DECRYPT */
#endif /* HAVE_AES_CBC */

#ifdef HAVE_AES_ECB
static int ti_sa2ul_AesEcb(Aes* aes, byte* out, const byte* in, word32 sz,
        int enc)
{
#ifdef WOLFSSL_SA2UL_DRIVER
    struct Sa2ulCtrl ctrl;

    /* see WOLFSSL_SA2UL_ECB_MIN_SZ in user_settings.h */
    if (sz < WOLFSSL_SA2UL_ECB_MIN_SZ || (sz % WC_AES_BLOCK_SIZE) != 0u ||
            sz > SA2UL_MAX_BUF) {
        return CRYPTOCB_UNAVAILABLE;
    }

    XMEMSET(&ctrl, 0, sizeof(ctrl));
    ctrl.op = enc ? SA2UL_OP_AES_ECB_ENCRYPT : SA2UL_OP_AES_ECB_DECRYPT;
    ctrl.sz = sz;

    if (ti_sa2ul_AesRun(aes, &ctrl, in, out, sz) != 0 ||
            ctrl.ret != SA2UL_DRIVER_OK) {
        return CRYPTOCB_UNAVAILABLE;
    }
    return 0;
#else
    (void)aes; (void)out; (void)in; (void)sz; (void)enc;
    return CRYPTOCB_UNAVAILABLE;
#endif
}
#endif /* HAVE_AES_ECB */

#ifdef HAVE_AESGCM
static int ti_sa2ul_AesGcmEncrypt(Aes* aes, byte* out,
        const byte* in, word32 sz,
        const byte* iv, word32 ivSz,
        byte* authTag, word32 authTagSz,
        const byte* authIn, word32 authInSz)
{
#ifdef WOLFSSL_SA2UL_DRIVER
    struct Sa2ulCtrl ctrl;

    if (sz == 0u || sz > SA2UL_MAX_BUF || ivSz != GCM_NONCE_MID_SZ ||
            authInSz > SA2UL_MAX_AAD_BYTES || authTag == NULL ||
            authTagSz == 0u || authTagSz > SA2UL_MAX_TAG_BYTES) {
        return CRYPTOCB_UNAVAILABLE;
    }

    XMEMSET(&ctrl, 0, sizeof(ctrl));
    ctrl.op = SA2UL_OP_AES_GCM_ENCRYPT;
    ctrl.sz = sz;
    ctrl.ivSz = ivSz;
    XMEMCPY(ctrl.iv, iv, ivSz);
    ctrl.aadSz = authInSz;
    if (authInSz != 0u) {
        XMEMCPY(ctrl.aad, authIn, authInSz);
    }
    ctrl.tagSz = authTagSz;

    if (ti_sa2ul_AesRun(aes, &ctrl, in, out, sz) != 0 ||
            ctrl.ret != SA2UL_DRIVER_OK) {
        return CRYPTOCB_UNAVAILABLE;
    }

    XMEMCPY(authTag, ctrl.tagOut, authTagSz);
    return 0;
#else
    (void)aes; (void)out; (void)in; (void)sz;
    (void)iv; (void)ivSz; (void)authTag; (void)authTagSz;
    (void)authIn; (void)authInSz;
    return CRYPTOCB_UNAVAILABLE;
#endif
}

#ifdef HAVE_AES_DECRYPT
static int ti_sa2ul_AesGcmDecrypt(Aes* aes, byte* out,
        const byte* in, word32 sz,
        const byte* iv, word32 ivSz,
        const byte* authTag, word32 authTagSz,
        const byte* authIn, word32 authInSz)
{
#ifdef WOLFSSL_SA2UL_DRIVER
    struct Sa2ulCtrl ctrl;

    if (sz == 0u || sz > SA2UL_MAX_BUF || ivSz != GCM_NONCE_MID_SZ ||
            authInSz > SA2UL_MAX_AAD_BYTES || authTag == NULL ||
            authTagSz == 0u || authTagSz > SA2UL_MAX_TAG_BYTES) {
        return CRYPTOCB_UNAVAILABLE;
    }

    XMEMSET(&ctrl, 0, sizeof(ctrl));
    ctrl.op = SA2UL_OP_AES_GCM_DECRYPT;
    ctrl.sz = sz;
    ctrl.ivSz = ivSz;
    XMEMCPY(ctrl.iv, iv, ivSz);
    ctrl.aadSz = authInSz;
    if (authInSz != 0u) {
        XMEMCPY(ctrl.aad, authIn, authInSz);
    }
    ctrl.tagSz = authTagSz;
    XMEMCPY(ctrl.tagIn, authTag, authTagSz);

    if (ti_sa2ul_AesRun(aes, &ctrl, in, out, sz) != 0) {
        return CRYPTOCB_UNAVAILABLE;
    }
    if (ctrl.ret == SA2UL_DRIVER_AUTH_FAILED) {
        /* the driver released no plaintext; out is untouched */
        return WC_NO_ERR_TRACE(AES_GCM_AUTH_E);
    }
    if (ctrl.ret != SA2UL_DRIVER_OK) {
        return CRYPTOCB_UNAVAILABLE;
    }
    return 0;
#else
    (void)aes; (void)out; (void)in; (void)sz;
    (void)iv; (void)ivSz; (void)authTag; (void)authTagSz;
    (void)authIn; (void)authInSz;
    return CRYPTOCB_UNAVAILABLE;
#endif
}
#endif /* HAVE_AES_DECRYPT */
#endif /* HAVE_AESGCM */
#endif /* !NO_AES && !WOLFSSL_TI_AM64X_A53_INTEGRITY_NO_AES */

#if !defined(WOLFSSL_TI_AM64X_A53_INTEGRITY_NO_SHA) && (!defined(NO_SHA256) || defined(WOLFSSL_SHA512))
#ifdef WOLFSSL_SA2UL_DRIVER
/* SA2UL hashes a whole message in one pass, so updates are accumulated
 * (one hash at a time, up to SA2UL_MAX_BUF bytes) and sent at Final. Any
 * time that can't work -- engine busy with another hash, message too long,
 * the object being copied (wc_Sha*Copy()/GetHash(), e.g. the TLS 1.3
 * transcript), or a hardware failure at Final -- the accumulated bytes are
 * "spilled" into the object's software state and it continues in software
 * (WC_HASH_FLAG_ISCOPY makes later callbacks decline). */

static int ti_sa2ul_HashSwUpdate(int type, void* obj, const byte* in,
        word32 inSz)
{
    if (inSz == 0u) {
        return 0;
    }
#ifndef NO_SHA256
    if (type == WC_HASH_TYPE_SHA256) {
        return wc_Sha256Update((wc_Sha256*)obj, in, inSz);
    }
#endif
#if !defined(NO_SHA256) && defined(WOLFSSL_SHA224)
    if (type == WC_HASH_TYPE_SHA224) {
        return wc_Sha224Update((wc_Sha224*)obj, in, inSz);
    }
#endif
#ifdef WOLFSSL_SHA384
    if (type == WC_HASH_TYPE_SHA384) {
        return wc_Sha384Update((wc_Sha384*)obj, in, inSz);
    }
#endif
#ifdef WOLFSSL_SHA512
    if (type == WC_HASH_TYPE_SHA512) {
        return wc_Sha512Update((wc_Sha512*)obj, in, inSz);
    }
#endif
    return BAD_FUNC_ARG;
}

/* Called with gSa2ulMutex held and obj owning the accumulator; returns
 * with it released. The accumulator stays owned during the replay so no
 * other hash can take it while unlocked. */
static int ti_sa2ul_HashSpill(int type, void* obj, word32* flags)
{
    int ret;

    *flags |= WC_HASH_FLAG_ISCOPY;
    ti_sa2ul_unlock();
    ret = ti_sa2ul_HashSwUpdate(type, obj, gSa2ulHashAccum, gSa2ulHashAccumLen);
    if (ti_sa2ul_lock() == 0) {
        ForceZero(gSa2ulHashAccum, gSa2ulHashAccumLen);
        gSa2ulHashAccumLen = 0;
        gSa2ulHashOwner = NULL;
        ti_sa2ul_unlock();
    }
    return ret;
}
#endif /* WOLFSSL_SA2UL_DRIVER */

static int ti_sa2ul_Hash(int type, void* obj, word32* flags, const byte* in,
        word32 inSz, byte* digest, word32 digestSz)
{
#ifdef WOLFSSL_SA2UL_DRIVER
    struct Sa2ulCtrl ctrl;
    int ret;

    if (in == NULL && digest == NULL) {
        return BAD_FUNC_ARG;
    }
    if ((*flags & WC_HASH_FLAG_ISCOPY) != 0) {
        return CRYPTOCB_UNAVAILABLE;
    }
    /* Lock-free fast paths. Only this object's own (single) thread ever
     * sets gSa2ulHashOwner to obj, so a racy read can't wrongly see obj. */
    if (gSa2ulHashOwner != obj) {
        if (in == NULL) {
            /* Final for a message that never claimed the accumulator */
            return CRYPTOCB_UNAVAILABLE;
        }
        if (inSz < WOLFSSL_SA2UL_HASH_MIN_SZ) {
            /* The message starts with a small update: treat it as a small
             * message (e.g. Hash_DRBG's many tiny SHA-256 calls) and do all
             * of it in software, with no locking or buffering. Messages fed
             * in small pieces therefore always run in software. */
            *flags |= WC_HASH_FLAG_ISCOPY;
            return CRYPTOCB_UNAVAILABLE;
        }
    }
    if (ti_sa2ul_lock() != 0) {
        return CRYPTOCB_UNAVAILABLE;
    }

    if (in != NULL) {
        /* Update */
        if (gSa2ulHashOwner != NULL && gSa2ulHashOwner != obj) {
            *flags |= WC_HASH_FLAG_ISCOPY;
            ti_sa2ul_unlock();
            return CRYPTOCB_UNAVAILABLE;
        }
        if (gSa2ulHashOwner == NULL) {
            gSa2ulHashOwner = obj;
            gSa2ulHashAccumLen = 0;
        }
        if ((word64)gSa2ulHashAccumLen + inSz > sizeof(gSa2ulHashAccum)) {
            ret = ti_sa2ul_HashSpill(type, obj, flags);
            if (ret == 0) {
                ret = ti_sa2ul_HashSwUpdate(type, obj, in, inSz);
            }
            return ret;
        }
        XMEMCPY(gSa2ulHashAccum + gSa2ulHashAccumLen, in, inSz);
        gSa2ulHashAccumLen += inSz;
        ti_sa2ul_unlock();
        return 0;
    }

    /* Final */
    if (gSa2ulHashOwner != obj) {
        ti_sa2ul_unlock();
        return CRYPTOCB_UNAVAILABLE;
    }
    if (gSa2ulHashAccumLen == 0u) {
        /* empty message (SA2UL rejects zero length): software, and give
         * the accumulator back */
        gSa2ulHashOwner = NULL;
        ti_sa2ul_unlock();
        return CRYPTOCB_UNAVAILABLE;
    }
    if (gSa2ulHashAccumLen < WOLFSSL_SA2UL_HASH_MIN_SZ) {
        /* too short to be worth an IODevice round trip (e.g. Hash_DRBG's
         * many small SHA-256 calls): finish in software */
        ret = ti_sa2ul_HashSpill(type, obj, flags);
        return (ret == 0) ? CRYPTOCB_UNAVAILABLE : ret;
    }

    XMEMSET(&ctrl, 0, sizeof(ctrl));
    switch (type) {
        case WC_HASH_TYPE_SHA224: ctrl.op = SA2UL_OP_SHA224; break;
        case WC_HASH_TYPE_SHA256: ctrl.op = SA2UL_OP_SHA256; break;
        case WC_HASH_TYPE_SHA384: ctrl.op = SA2UL_OP_SHA384; break;
        default:                  ctrl.op = SA2UL_OP_SHA512; break;
    }
    ctrl.sz = gSa2ulHashAccumLen;

    ret = ti_sa2ul_IodeviceCall(&ctrl, gSa2ulHashAccum, gSa2ulHashAccumLen,
            NULL, 0);
    if (ret != 0 || ctrl.ret != SA2UL_DRIVER_OK) {
        /* finish in software instead */
        ret = ti_sa2ul_HashSpill(type, obj, flags);
        return (ret == 0) ? CRYPTOCB_UNAVAILABLE : ret;
    }

    ForceZero(gSa2ulHashAccum, gSa2ulHashAccumLen);
    gSa2ulHashAccumLen = 0;
    gSa2ulHashOwner = NULL;
    ti_sa2ul_unlock();

    XMEMCPY(digest, ctrl.digestOut, digestSz);
    return 0;
#else
    (void)type; (void)obj; (void)flags; (void)in; (void)inSz;
    (void)digest; (void)digestSz;
    return CRYPTOCB_UNAVAILABLE;
#endif
}

#ifdef WOLF_CRYPTO_CB_COPY
/* wc_Sha*Copy(): make sure src's software state holds everything before
 * wolfCrypt memcpy()s it, then let the normal copy happen. */
static int ti_sa2ul_HashCopy(int type, void* src, word32* srcFlags)
{
#ifdef WOLFSSL_SA2UL_DRIVER
    if (gSa2ulHashOwner != src) {
        /* nothing buffered for src (lock-free, see ti_sa2ul_Hash()) */
        return CRYPTOCB_UNAVAILABLE;
    }
    if (ti_sa2ul_lock() != 0) {
        return CRYPTOCB_UNAVAILABLE;
    }
    if (gSa2ulHashOwner == src) {
        int ret = ti_sa2ul_HashSpill(type, src, srcFlags);
        if (ret != 0) {
            return ret;
        }
    }
    else {
        ti_sa2ul_unlock();
    }
#else
    (void)type; (void)src; (void)srcFlags;
#endif
    return CRYPTOCB_UNAVAILABLE;
}
#endif /* WOLF_CRYPTO_CB_COPY */

static int ti_sa2ul_HashTeardown(void* obj)
{
#ifdef WOLFSSL_SA2UL_DRIVER
    if (gSa2ulHashOwner == obj && ti_sa2ul_lock() == 0) {
        if (gSa2ulHashOwner == obj) {
            ForceZero(gSa2ulHashAccum, gSa2ulHashAccumLen);
            gSa2ulHashOwner = NULL;
            gSa2ulHashAccumLen = 0;
        }
        ti_sa2ul_unlock();
    }
#else
    (void)obj;
#endif
    /* let wolfCrypt's own free run too */
    return CRYPTOCB_UNAVAILABLE;
}
#endif /* !WOLFSSL_TI_AM64X_A53_INTEGRITY_NO_SHA && (!NO_SHA256 || WOLFSSL_SHA512) */

static int ti_sa2ul_CryptoDevCb(int devId, wc_CryptoInfo* info, void* devCtx)
{
    int ret = CRYPTOCB_UNAVAILABLE;

    WOLFSSL_ENTER("ti_sa2ul_CryptoDevCb");

    (void)devCtx;

    if (info == NULL)
        return BAD_FUNC_ARG;
    if (devId == INVALID_DEVID)
        return CRYPTOCB_UNAVAILABLE;

#ifdef DEBUG_CRYPTOCB
    wc_CryptoCb_InfoString(info);
#endif

    if (info->algo_type == WC_ALGO_TYPE_CIPHER)
    {
#if !defined(NO_AES) && !defined(WOLFSSL_TI_AM64X_A53_INTEGRITY_NO_AES)
        if (0) {
            /* nothing */
        }
# if defined(WOLFSSL_SA2UL_DRIVER) && defined(WOLF_CRYPTO_CB_AES_SETKEY)
        else if (info->cipher.type == WC_CIPHER_AES) {
            ret = ti_sa2ul_AesSetKey(info->cipher.aessetkey.aes,
                                      info->cipher.aessetkey.key,
                                      info->cipher.aessetkey.keySz);
        }
# endif /* WOLFSSL_SA2UL_DRIVER && WOLF_CRYPTO_CB_AES_SETKEY */
# if defined(HAVE_AES_CBC)
        else if (info->cipher.type == WC_CIPHER_AES_CBC) {
            Aes* aes = info->cipher.aescbc.aes;
            if (aes == NULL)
                return BAD_FUNC_ARG;
            if (check_aes_keylength(aes->keylen) != 0)
                return CRYPTOCB_UNAVAILABLE; /* fall back to sw */
            if (info->cipher.enc) {
                ret = ti_sa2ul_AesCbcEncrypt(aes,
                                             info->cipher.aescbc.out,
                                             info->cipher.aescbc.in,
                                             info->cipher.aescbc.sz);
            }
#  ifdef HAVE_AES_DECRYPT
            else {
                ret = ti_sa2ul_AesCbcDecrypt(aes,
                                             info->cipher.aescbc.out,
                                             info->cipher.aescbc.in,
                                             info->cipher.aescbc.sz);
            }
#  endif /* HAVE_AES_DECRYPT */
        }
# endif /* HAVE_AES_CBC */
# if defined(HAVE_AES_ECB)
        else if (info->cipher.type == WC_CIPHER_AES_ECB) {
            Aes* aes = info->cipher.aesecb.aes;
            if (aes == NULL)
                return BAD_FUNC_ARG;
            if (check_aes_keylength(aes->keylen) != 0)
                return CRYPTOCB_UNAVAILABLE; /* fall back to sw */
            ret = ti_sa2ul_AesEcb(aes, info->cipher.aesecb.out,
                                  info->cipher.aesecb.in,
                                  info->cipher.aesecb.sz,
                                  info->cipher.enc);
        }
# endif /* HAVE_AES_ECB */
# if defined(HAVE_AESGCM)
        else if (info->cipher.type == WC_CIPHER_AES_GCM) {
            if (info->cipher.enc) {
                Aes* aes = info->cipher.aesgcm_enc.aes;
                if (aes == NULL)
                    return BAD_FUNC_ARG;
                if (check_aes_keylength(aes->keylen) != 0 ||
                    info->cipher.aesgcm_enc.sz == 0) {
                        return CRYPTOCB_UNAVAILABLE; /* fall back to sw */
                }
                ret = ti_sa2ul_AesGcmEncrypt(aes,
                        info->cipher.aesgcm_enc.out,
                        info->cipher.aesgcm_enc.in,
                        info->cipher.aesgcm_enc.sz,
                        info->cipher.aesgcm_enc.iv,
                        info->cipher.aesgcm_enc.ivSz,
                        info->cipher.aesgcm_enc.authTag,
                        info->cipher.aesgcm_enc.authTagSz,
                        info->cipher.aesgcm_enc.authIn,
                        info->cipher.aesgcm_enc.authInSz);
            }
#  ifdef HAVE_AES_DECRYPT
            else {
                Aes* aes = info->cipher.aesgcm_dec.aes;
                if (aes == NULL)
                    return BAD_FUNC_ARG;
                if (check_aes_keylength(aes->keylen) != 0 ||
                    info->cipher.aesgcm_dec.sz == 0) {
                        return CRYPTOCB_UNAVAILABLE; /* fall back to sw */
                }
                ret = ti_sa2ul_AesGcmDecrypt(aes,
                        info->cipher.aesgcm_dec.out,
                        info->cipher.aesgcm_dec.in,
                        info->cipher.aesgcm_dec.sz,
                        info->cipher.aesgcm_dec.iv,
                        info->cipher.aesgcm_dec.ivSz,
                        info->cipher.aesgcm_dec.authTag,
                        info->cipher.aesgcm_dec.authTagSz,
                        info->cipher.aesgcm_dec.authIn,
                        info->cipher.aesgcm_dec.authInSz);
            }
#  endif /* HAVE_AES_DECRYPT */
        }
# endif /* HAVE_AESGCM */
#endif /* !NO_AES && !WOLFSSL_TI_AM64X_A53_INTEGRITY_NO_AES */
    }
    else if (info->algo_type == WC_ALGO_TYPE_HASH)
    {
#if !defined(WOLFSSL_TI_AM64X_A53_INTEGRITY_NO_SHA) && (!defined(NO_SHA256) || defined(WOLFSSL_SHA512))
        if (0) {
            /* nothing */
        }
# ifndef NO_SHA256
        else if (info->hash.type == WC_HASH_TYPE_SHA256) {
            wc_Sha256* sha256 = info->hash.sha256;
            ret = ti_sa2ul_Hash(WC_HASH_TYPE_SHA256, sha256, &sha256->flags,
                                info->hash.in, info->hash.inSz,
                                info->hash.digest, WC_SHA256_DIGEST_SIZE);
        }
# endif /* !NO_SHA256 */
# if !defined(NO_SHA256) && defined(WOLFSSL_SHA224)
        else if (info->hash.type == WC_HASH_TYPE_SHA224) {
            wc_Sha224* sha224 = info->hash.sha224;
            ret = ti_sa2ul_Hash(WC_HASH_TYPE_SHA224, sha224, &sha224->flags,
                                info->hash.in, info->hash.inSz,
                                info->hash.digest, WC_SHA224_DIGEST_SIZE);
        }
# endif /* !NO_SHA256 && WOLFSSL_SHA224 */
# ifdef WOLFSSL_SHA384
        else if (info->hash.type == WC_HASH_TYPE_SHA384) {
            wc_Sha384* sha384 = info->hash.sha384;
            ret = ti_sa2ul_Hash(WC_HASH_TYPE_SHA384, sha384, &sha384->flags,
                                info->hash.in, info->hash.inSz,
                                info->hash.digest, WC_SHA384_DIGEST_SIZE);
        }
# endif /* WOLFSSL_SHA384 */
# ifdef WOLFSSL_SHA512
        else if (info->hash.type == WC_HASH_TYPE_SHA512) {
            wc_Sha512* sha512 = info->hash.sha512;
            /* SHA-384/512-224/512-256 share wc_Sha512 but not this path */
            if (sha512->hashType == WC_HASH_TYPE_SHA512) {
                ret = ti_sa2ul_Hash(WC_HASH_TYPE_SHA512, sha512,
                                    &sha512->flags, info->hash.in,
                                    info->hash.inSz, info->hash.digest,
                                    WC_SHA512_DIGEST_SIZE);
            }
        }
# endif /* WOLFSSL_SHA512 */
#endif /* !WOLFSSL_TI_AM64X_A53_INTEGRITY_NO_SHA && (!NO_SHA256 || WOLFSSL_SHA512) */
    }
#ifdef WOLF_CRYPTO_CB_COPY
    else if (info->algo_type == WC_ALGO_TYPE_COPY)
    {
# if !defined(WOLFSSL_TI_AM64X_A53_INTEGRITY_NO_SHA) && (!defined(NO_SHA256) || defined(WOLFSSL_SHA512))
        if (info->copy.algo == WC_ALGO_TYPE_HASH) {
#  ifndef NO_SHA256
            if (info->copy.type == WC_HASH_TYPE_SHA256) {
                wc_Sha256* src = (wc_Sha256*)info->copy.src;
                ret = ti_sa2ul_HashCopy(WC_HASH_TYPE_SHA256, src, &src->flags);
            }
#  endif
#  if defined(WOLFSSL_SHA224)
            if (info->copy.type == WC_HASH_TYPE_SHA224) {
                wc_Sha224* src = (wc_Sha224*)info->copy.src;
                ret = ti_sa2ul_HashCopy(WC_HASH_TYPE_SHA224, src, &src->flags);
            }
#  endif
#  ifdef WOLFSSL_SHA384
            if (info->copy.type == WC_HASH_TYPE_SHA384) {
                wc_Sha384* src = (wc_Sha384*)info->copy.src;
                ret = ti_sa2ul_HashCopy(WC_HASH_TYPE_SHA384, src, &src->flags);
            }
#  endif
#  ifdef WOLFSSL_SHA512
            if (info->copy.type == WC_HASH_TYPE_SHA512) {
                wc_Sha512* src = (wc_Sha512*)info->copy.src;
                ret = ti_sa2ul_HashCopy(WC_HASH_TYPE_SHA512, src, &src->flags);
            }
#  endif
        }
# endif
    }
#endif /* WOLF_CRYPTO_CB_COPY */
#ifdef WOLF_CRYPTO_CB_FREE
    else if (info->algo_type == WC_ALGO_TYPE_FREE)
    {
# if !defined(WOLFSSL_TI_AM64X_A53_INTEGRITY_NO_SHA) && (!defined(NO_SHA256) || defined(WOLFSSL_SHA512))
        if (info->free.algo == WC_ALGO_TYPE_HASH &&
                (info->free.type == WC_HASH_TYPE_SHA224 ||
                 info->free.type == WC_HASH_TYPE_SHA256 ||
                 info->free.type == WC_HASH_TYPE_SHA384 ||
                 info->free.type == WC_HASH_TYPE_SHA512)) {
            ret = ti_sa2ul_HashTeardown(info->free.obj);
        }
# endif
# if defined(WOLFSSL_SA2UL_DRIVER) && !defined(NO_AES) && \
     !defined(WOLFSSL_TI_AM64X_A53_INTEGRITY_NO_AES)
        if (info->free.algo == WC_ALGO_TYPE_CIPHER &&
                info->free.type == WC_CIPHER_AES) {
            ti_sa2ul_AesForgetKey((const Aes*)info->free.obj);
            /* CRYPTOCB_UNAVAILABLE: wc_AesFree() still zeroes the Aes */
        }
# endif
    }
#endif /* WOLF_CRYPTO_CB_FREE */

    return ret;
}

int ti_sa2ul_port_init(void)
{
#ifdef WOLFSSL_SA2UL_DRIVER
    if (!gSa2ulMutexInit) {
        if (wc_InitMutex(&gSa2ulMutex) != 0) {
            return BAD_MUTEX_E;
        }
        gSa2ulMutexInit = 1;
    }
#endif
    return wc_CryptoCb_RegisterDevice(WOLFSSL_TI_SA2UL_DEVID,
                                       ti_sa2ul_CryptoDevCb, NULL);
}

#endif /* WOLFSSL_TI_AM64X_A53_INTEGRITY */

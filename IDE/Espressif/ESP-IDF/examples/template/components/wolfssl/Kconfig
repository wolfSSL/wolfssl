## IDE/Espressif/ESP-IDF/examples/template/sdkconfig.defaults
```kconfig
CONFIG_FREERTOS_HZ=1000
CONFIG_ESP32_DEFAULT_CPU_FREQ_240=y

#
# Default main stack size
#
# This is typically way bigger than needed for stack size. See user_settings.h
#
CONFIG_ESP_MAIN_TASK_STACK_SIZE=10500

# Legacy stack size for older ESP-IDF versions
CONFIG_MAIN_TASK_STACK_SIZE=10500

#
# Compiler options
#
CONFIG_COMPILER_OPTIMIZATION_DEFAULT=y
CONFIG_COMPILER_OPTIMIZATION_ASSERTIONS_ENABLE=y
CONFIG_COMPILER_OPTIMIZATION_ASSERTION_LEVEL=2
CONFIG_COMPILER_HIDE_PATHS_MACROS=y
CONFIG_COMPILER_STACK_CHECK_MODE_NORM=y
CONFIG_COMPILER_STACK_CHECK=y
```

## IDE/Espressif/ESP-IDF/examples/template/sdkconfig.defaults.esp8266
```kconfig
# ESP8266 WDT
# CONFIG_ESP_PANIC_PRINT_REBOOT is not set
CONFIG_ESP_PANIC_PRINT_REBOOT=n
CONFIG_ESP_PANIC_PRINT_HALT=y

# Enable wolfSSL TLS in esp-tls (not yet supported in RTOS SDK 3.4
CONFIG_ESP_TLS_USING_WOLFSSL=n
CONFIG_TLS_STACK_WOLFSSL=n

# Bundles take up flash space and are disabled unless otherwise known to be needed
CONFIG_WOLFSSL_CERTIFICATE_BUNDLE=n
# CONFIG_ESP_WOLFSSL_SMALL_CERT_VERIFY=y
# CONFIG_ESP_TLS_INSECURE=y

# Disable mbedTLS
CONFIG_ESP_TLS_USING_MBEDTLS=y
CONFIG_MBEDTLS_CERTIFICATE_BUNDLE=n

# ESP8266 Memory
CONFIG_FREERTOS_GLOBAL_DATA_LINK_IRAM=y
CONFIG_HEAP_DISABLE_IRAM=y

# ESP8266 Watchdog:
CONFIG_TASK_WDT=n
CONFIG_TASK_WDT_PANIC=n

# ESP8266 WDT
# CONFIG_ESP_PANIC_PRINT_REBOOT is not set
CONFIG_ESP_PANIC_PRINT_REBOOT=n
CONFIG_ESP_PANIC_PRINT_HALT=y
```

## IDE/Espressif/ESP-IDF/examples/wolfssl_benchmark/main/Kconfig.projbuild
```kconfig
# Kconfig main
#
# Copyright (C) 2006-2025 wolfSSL Inc.
#
# This file is part of wolfSSL.
#
# wolfSSL is free software; you can redistribute it and/or modify
# it under the terms of the GNU General Public License as published by
# the Free Software Foundation; either version 3 of the License, or
# (at your option) any later version.
#
# wolfSSL is distributed in the hope that it will be useful,
# but WITHOUT ANY WARRANTY; without even the implied warranty of
# MERCHANTABILITY or FITNESS FOR A PARTICULAR PURPOSE.  See the
# GNU General Public License for more details.
#
# You should have received a copy of the GNU General Public License
# along with this program; if not, write to the Free Software
# Foundation, Inc., 51 Franklin Street, Fifth Floor, Boston, MA 02110-1335, USA
#

# Kconfig File Version 5.7.2.001 for wolfssl_template

menu "Example Configuration"

choice WOLFSSL_EXAMPLE_CHOOSE
    prompt "Choose Example (See wolfssl/include/user_settings.h)"
    default WOLFSSL_EXAMPLE_NAME_NONE
    help
        The user settings file can be adjusted to specific wolfSSL examples.

    config WOLFSSL_EXAMPLE_NAME_TEMPLATE
        bool "wolfSSL Template"
        help
            The sample template app compiles in wolfSSL and prints the current wolfSSL Version. Nothing more.

    config WOLFSSL_EXAMPLE_NAME_TEST
        bool "wolfSSL Test"
        help
            This app tests all cryptographic functions currently enabled. See also Benchmark performance app.

    config WOLFSSL_EXAMPLE_NAME_BENCHMARK
        bool "wolfSSL Benchmark"
        help
            Benchmark performance app. See also cryptographic test.

    config WOLFSSL_EXAMPLE_NAME_TLS_CLIENT
        bool "TLS Client"
        help
            TLS Client Example app. Needs WiFi and a listening server on port 11111.

    config WOLFSSL_EXAMPLE_NAME_TLS_SERVER
        bool "TLS Server"
        help
            TLS Server Example app. Needs WiFi. More interesting with a TLS client using port 11111.

    config WOLFSSL_EXAMPLE_NAME_WOLFSSH_TEMPLATE
        bool "SSH Template App"
        help
            Bare-bones Hello World app that only compiles in wolfSSL and wolfSSH.
            See wolfSSL/wolfssh on GitHub.

    config WOLFSSL_EXAMPLE_NAME_WOLFSSH_ECHOSERVER
        bool "SSH Echo Server"
        help
            See wolfSSL/wolfssh on GitHub.

    config WOLFSSL_EXAMPLE_NAME_ESP32_SSH_SERVER
        bool "SSH to UART Server for the ESP32"
        help
            See wolfSSL/wolfssh-examples on GitHub.

    config WOLFSSL_EXAMPLE_NAME_ESP8266_SSH_SERVER
        bool "SSH to UART Server for the ESP8266"
        help
            See wolfSSL/wolfssh-examples on GitHub.

    config WOLFSSL_EXAMPLE_NAME_WOLFMQTT_TEMPLATE
        bool "MQTT Template"
        help
            See wolfSSL/wolfmqtt on GitHub.

    config WOLFSSL_EXAMPLE_NAME_WOLFMQTT_AWS_IOT_MQTT
        bool "MQTT AWS IoT"
        help
            See wolfSSL/wolfmqtt on GitHub.

    config WOLFTPM_EXAMPLE_NAME_ESPRESSIF
        bool "TPM Test Example for the ESP32"
        help
            See wolfSSL/wolfTPM on GitHub.

    config WOLFSSL_EXAMPLE_NAME_NONE
        bool "Other"
        help
            A specific example app is not defined.

endchoice

config BENCH_ARGV
    string "Arguments for benchmark test"
    default "-lng 0"
    help
        -? <num>    Help, print this usage
                     0: English, 1: Japanese
        -csv        Print terminal output in csv format
        -base10     Display bytes as power of 10 (eg 1 kB = 1000 Bytes)
        -no_aad     No additional authentication data passed.
        -dgst_full  Full digest operation performed.
        -rsa_sign   Measure RSA sign/verify instead of encrypt/decrypt.
        -<alg>      Algorithm to benchmark. Available algorithms include:
                    cipher aes-cbc aes-gcm chacha20 chacha20-poly1305
                    digest md5 poly1305 sha sha2 sha224 sha256 sha384 sha512 sha3
                    sha3-224 sha3-256 sha3-384 sha3-512
                    mac hmac hmac-md5 hmac-sha hmac-sha224 hmac-sha256 hmac-sha384
                    hmac-sha512
                    asym rsa rsa-sz dh ecc-kg ecc
                    other rng
        -lng <num>  Display benchmark result by specified language.
                    0: English, 1: Japanese
        <num>       Size of block in bytes

        e.g -lng 1
        e.g sha

endmenu
```

## IDE/Espressif/ESP-IDF/examples/wolfssl_benchmark/sdkconfig.defaults
```kconfig
CONFIG_BENCH_ARGV="-lng 0"
CONFIG_MAIN_TASK_STACK_SIZE=7500
CONFIG_ESP_TASK_WDT_CHECK_IDLE_TASK_CPU0=
CONFIG_FREERTOS_HZ=1000
CONFIG_ESP32_DEFAULT_CPU_FREQ_240=y
CONFIG_ESP32_DEFAULT_CPU_FREQ_MHZ=240
#
# Compiler options
#
CONFIG_COMPILER_OPTIMIZATION_DEFAULT=y
CONFIG_COMPILER_OPTIMIZATION_ASSERTIONS_ENABLE=y
CONFIG_COMPILER_OPTIMIZATION_ASSERTION_LEVEL=2
CONFIG_COMPILER_HIDE_PATHS_MACROS=y
CONFIG_COMPILER_STACK_CHECK_MODE_NORM=y
CONFIG_COMPILER_STACK_CHECK=y
```

## IDE/Espressif/ESP-IDF/examples/wolfssl_client/main/Kconfig.projbuild
```kconfig
menu "Example wolfSSL Configuration"

choice WOLFSSL_EXAMPLE_CHOOSE
    prompt "Choose Example (See wolfssl/include/user_settings.h)"
    default WOLFSSL_EXAMPLE_NAME_NONE
    help
        The user settings file can be adjusted to specific wolfSSL examples.

    config WOLFSSL_EXAMPLE_NAME_TEMPLATE
        bool "wolfSSL Template"
        help
            The sample template app compiles in wolfSSL and prints the current wolfSSL Version. Nothing more.

    config WOLFSSL_EXAMPLE_NAME_TEST
        bool "wolfSSL Test"
        help
            This app tests all cryptographic functions currently enabled. See also Benchmark performance app.

    config WOLFSSL_EXAMPLE_NAME_BENCHMARK
        bool "wolfSSL Benchmark"
        help
            Benchmark performance app. See also cryptographic test.

    config WOLFSSL_EXAMPLE_NAME_TLS_CLIENT
        bool "TLS Client"
        help
            TLS Client Example app. Needs WiFi and a listening server on port 11111.

    config WOLFSSL_EXAMPLE_NAME_TLS_SERVER
        bool "TLS Server"
        help
            TLS Server Example app. Needs WiFi. More interesting with a TLS client using port 11111.

    config WOLFSSL_EXAMPLE_NAME_WOLFSSH_TEMPLATE
        bool "SSH Template App"
        help
            Bare-bones Hello World app that only compiles in wolfSSL and wolfSSH.
            See wolfSSL/wolfssh on GitHub.

    config WOLFSSL_EXAMPLE_NAME_WOLFSSH_ECHOSERVER
        bool "SSH Echo Server"
        help
            See wolfSSL/wolfssh on GitHub.

    config WOLFSSL_EXAMPLE_NAME_WOLFSSH_ECHOSERVER
        bool "SSH Echo Server"
        help
            See wolfSSL/wolfssh on GitHub.

    config WOLFSSL_EXAMPLE_NAME_ESP32_SSH_SERVER
        bool "SSH to UART Server for the ESP32"
        help
            See wolfSSL/wolfssh-examples on GitHub.

    config WOLFSSL_EXAMPLE_NAME_ESP8266_SSH_SERVER
        bool "SSH to UART Server for the ESP8266"
        help
            See wolfSSL/wolfssh-examples on GitHub.

    config WOLFSSL_EXAMPLE_NAME_WOLFMQTT_TEMPLATE
        bool "MQTT Template"
        help
            See wolfSSL/wolfmqtt on GitHub.

    config WOLFSSL_EXAMPLE_NAME_WOLFMQTT_AWS_IOT_MQTT
        bool "MQTT AWS IoT"
        help
            See wolfSSL/wolfmqtt on GitHub.

    config WOLFTPM_EXAMPLE_NAME_ESPRESSIF
        bool "TPM Test Example for the ESP32"
        help
            See wolfSSL/wolfTPM on GitHub.

    config WOLFSSL_EXAMPLE_NAME_NONE
        bool "Other"
        help
            A specific example app is not defined.

endchoice

config WOLFSSL_TARGET_HOST
    string "Target host"
    default "127.0.0.1"
    help
        host address for the example to connect

config WOLFSSL_TARGET_PORT
    int "Target port"
    default 11111
    help
        host port for the example to connect

endmenu
```

## IDE/Espressif/ESP-IDF/examples/wolfssl_client/sdkconfig.defaults
```kconfig
# sdkconfig.defaults for ESP8266 + ESP32

# CONFIG_ESP_PANIC_PRINT_REBOOT is not set
CONFIG_ESP_PANIC_PRINT_REBOOT=n
CONFIG_ESP_PANIC_PRINT_HALT=y

# CONFIG_ESP_HTTP_CLIENT_ENABLE_HTTPS is not set
CONFIG_ESP_HTTP_CLIENT_ENABLE_HTTPS=n

CONFIG_FREERTOS_GLOBAL_DATA_LINK_IRAM=y
CONFIG_HEAP_DISABLE_IRAM=y
CONFIG_FREERTOS_HZ=1000
#
# Partition Table
#
# CONFIG_PARTITION_TABLE_SINGLE_APP is not set
CONFIG_PARTITION_TABLE_SINGLE_APP_LARGE=y
# CONFIG_PARTITION_TABLE_TWO_OTA is not set
# CONFIG_PARTITION_TABLE_CUSTOM is not set
CONFIG_PARTITION_TABLE_CUSTOM_FILENAME="partitions.csv"
CONFIG_PARTITION_TABLE_FILENAME="partitions_singleapp_large.csv"
CONFIG_PARTITION_TABLE_OFFSET=0x8000
CONFIG_PARTITION_TABLE_MD5=y
# end of Partition Table
```
